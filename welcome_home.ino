#include <ESP8266WiFi.h>
#include <PubSubClient.h>

#include <Wire.h>  // Include Wire if you're using I2C
#include <SPI.h>  // Include SPI if you're using SPI
#include <SFE_MicroOLED.h>  // Include the SFE_MicroOLED library
#define PIN_RESET 255
#define DC_JUMPER 0
MicroOLED oled(PIN_RESET, DC_JUMPER); // Example I2C declaration

WiFiClient espClient;
PubSubClient client(espClient);

const char* ssid = "...";
const char* password = "...";

const char* mqtt_host = "192.168.0.XX";
const int mqtt_port = 1883;
const char* mqtt_user = "...";
const char* mqtt_pwd = "...";

uint8_t work [] = {
  0x00, 0x00, 0x00, 0x00, 0xF8, 0xFC, 0xFE, 0xFE, 0x7E, 0x7E, 0x7E, 0x7E, 0x7E, 0x7E, 0x7E, 0x7E,
  0x7E, 0x7F, 0x7F, 0x7E, 0x7E, 0x7E, 0x7E, 0xBE, 0xFE, 0xFC, 0xF8, 0x00, 0x00, 0x00, 0x00, 0x00,
  0x00, 0x00, 0x00, 0x00, 0x00, 0x00, 0x00, 0x00, 0x00, 0x00, 0x00, 0x00, 0x00, 0x00, 0x00, 0x00,
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  0x01, 0x01, 0x01, 0x01, 0x01, 0x01, 0x01, 0x01, 0x01, 0x01, 0x00, 0x00, 0x00, 0x00, 0x00, 0x00
};
uint8_t home [] = {
  0x00, 0x00, 0x00, 0x00, 0x00, 0x00, 0x00, 0x00, 0x00, 0x00, 0x00, 0x00, 0x00, 0x00, 0x00, 0x00,
  0x00, 0x00, 0x00, 0x00, 0x00, 0x00, 0x00, 0x00, 0x80, 0xC0, 0xE0, 0xF0, 0xF8, 0xFC, 0xFE, 0xFE,
  0xFE, 0xFE, 0xFC, 0xF8, 0xF0, 0xE0, 0xC0, 0x80, 0x00, 0xC0, 0xF0, 0xF0, 0xF8, 0xF8, 0xF8, 0xF0,
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  0x7F, 0x1F, 0x00, 0x00, 0x00, 0x00, 0x00, 0x00, 0x00, 0x00, 0x00, 0x00, 0x00, 0x00, 0x00, 0x00
};
uint8_t away [] = {
  0x00, 0x00, 0x00, 0x00, 0x00, 0x00, 0x00, 0x00, 0x00, 0x00, 0x00, 0x00, 0x00, 0x00, 0x00, 0x00,
  0x00, 0x00, 0x00, 0x00, 0x00, 0x00, 0x00, 0x00, 0x00, 0x00, 0x00, 0x00, 0x00, 0x00, 0x7C, 0xFE,
  0xFF, 0xFF, 0xFF, 0xFF, 0xFE, 0xFE, 0x38, 0x00, 0x00, 0x00, 0x00, 0x00, 0x00, 0x00, 0x00, 0x00,
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  0x00, 0x00, 0x00, 0x00, 0x00, 0x00, 0x00, 0x00, 0x00, 0x00, 0x00, 0x00, 0x00, 0x00, 0x00, 0x00
};

int inversion_animation_frame_duration = 200;
int inversion_animation_duration = 5;
int current_inversion_iteration = 0;
bool inversion_enabled = false;
bool inverted_display = false;

void oled_setup() {
  oled.begin();
  oled.setFontType(0);
  oled_clear();  
}

void oled_clear() {
  oled.clear(PAGE);
  oled.setCursor(0,0);
}

void oled_println(String text) {
  oled_print(text);
  oled.println("");
  oled.display();
  Serial.println("");
}

void oled_print(String text) {
  oled.print(text);
  oled.display();
  Serial.print(text);
}

void oled_image(uint8_t * image) {
  oled_clear();
  oled.drawBitmap(image);
  oled.display();
}

void mqtt_callback(char* topic, byte* payload, unsigned int length) { 
  String message = String((char *) payload).substring(0,length);

  if(message.compareTo("home") == 0) {
    oled_image(home);
  } else if(message.compareTo("work") == 0) {
    oled_image(work);
  } else if(message.compareTo("away") == 0) {
    oled_image(away);
  } else {
    idle();
  }
  
  oled_enable_inversion(2);
}

void setup() {
  oled_setup();
  Serial.begin(9600);
  oled_print("Booting...");

  WiFi.mode(WIFI_STA);
  WiFi.begin(ssid, password);

  oled_clear();
  oled_print("WIFI...");
  while (WiFi.waitForConnectResult() != WL_CONNECTED) {
    oled_print("FAIL!");
    oled_print("Rebooting...");
    delay(5000);
    ESP.restart();
  }
  oled_println("OK");
  oled_println(WiFi.localIP().toString());

  delay(2000);

  oled_print("MQTT...");
  while (!client.connected()) {
    client.setServer(mqtt_host, 1883);
    client.setCallback(mqtt_callback);
    if(client.connect("test_device_location_display", mqtt_user, mqtt_pwd)) {
      client.subscribe("test_device/location");
    } else {
      oled_print("FAIL!");
      oled_print("Rebooting...");
      delay(5000);
      ESP.restart();      
    }
  }
  oled_println("OK");
  delay(1000);
  idle();
}

void idle() {
  oled_clear();
  oled.setCursor(24,24);
  oled_print("..."); 
}

void oled_enable_inversion(int duration) {
  inversion_animation_duration = duration;
  inversion_enabled = true;
  current_inversion_iteration = 0;
  inverted_display = true;
}

void oled_disable_inversion() {
  inversion_enabled = false;
  current_inversion_iteration = 0;
  inverted_display = false;
}

void oled_loop() {
  if (inversion_enabled) {
    oled.invert(inverted_display);
    
    inverted_display = !inverted_display;

    // increment after full cycle (false -> true)
    if (inverted_display) {
      current_inversion_iteration++;
    }

    if (current_inversion_iteration == inversion_animation_duration) {
      oled_disable_inversion();
    }
    delay(inversion_animation_frame_duration);
  }  
}

void loop() {
  client.loop();
  oled_loop();
}
